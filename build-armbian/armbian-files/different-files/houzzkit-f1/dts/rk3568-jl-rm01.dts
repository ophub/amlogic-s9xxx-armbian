// SPDX-License-Identifier: (GPL-2.0+ OR MIT)
/*
 * SZZN RK3568-JL-RM01 (RZW03) board device tree.
 *
 * Built against the vendor RK3568 Linux 6.1 BSP:
 *   rk3568-jl-rm01.dtsi  -> board definitions
 *   rk3568.dtsi          -> RK3568 SoC
 *   rk3568-linux.dtsi    -> Linux runtime additions
 *
 * Board-specific Armbian adjustments:
 *   - Enable UART2 (serial@fe660000) as the standard serial console.
 *   - Name the NPU interrupt ("npu_irq"); the rknpu driver (v0.9.x)
 *     resolves its IRQ by name.
 */

/dts-v1/;

#include "rk3568-jl-rm01.dtsi"

/ {
	model = "RM01 HDMI (Linux)";
	compatible = "rockchip,rk3568-rzw03", "rockchip,rk3568";
};

&uart2 {
	status = "okay";
};

&rknpu {
	interrupt-names = "npu_irq";
};
